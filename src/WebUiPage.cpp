#include "WebUiPage.h"
#include <Arduino.h>

namespace {
const char kHtml[] PROGMEM = R"KHAIRCSTAGE3A(<!doctype html>
<html lang="vi">
<head>
  <meta charset="utf-8">
  <meta name="viewport" content="width=device-width,initial-scale=1,viewport-fit=cover">
  <meta name="theme-color" content="#081322">
  <meta name="apple-mobile-web-app-capable" content="yes">
  <meta name="apple-mobile-web-app-title" content="KhaiRC Toshiba">
  <meta name="apple-mobile-web-app-status-bar-style" content="black-translucent">
  <link rel="manifest" href="/web/manifest.webmanifest">
  <link rel="icon" href="/web/icon.svg" type="image/svg+xml">
  <link rel="apple-touch-icon" href="/web/icon.png">
  <title>KhaiRC · Toshiba AC</title>
  <style>
    :root{color-scheme:dark;font-family:-apple-system,BlinkMacSystemFont,'Segoe UI',Arial,sans-serif;--bg:#081322;--card:#142238;--line:#2a3e54;--accent:#65d6ff;--muted:#a5b6c9;--good:#65e0b6;--bad:#ffa5ac}
    *{box-sizing:border-box}body{margin:0;background:radial-gradient(circle at 10% -10%,#1c4163 0%,transparent 40%),linear-gradient(#081322,#0b1829);color:#eff8ff;min-height:100vh;min-height:100dvh}
    main{max-width:510px;margin:auto;padding:calc(28px + env(safe-area-inset-top)) 18px calc(24px + env(safe-area-inset-bottom))}
    .header{display:flex;justify-content:space-between;align-items:center;margin-bottom:22px;gap:12px}.eyebrow{font-size:11px;letter-spacing:.17em;text-transform:uppercase;color:var(--accent);font-weight:800}.heading{font-size:26px;letter-spacing:-.04em;margin:5px 0 0}.status-pill{border:1px solid var(--line);border-radius:99px;padding:9px 12px;font-size:12px;white-space:nowrap;color:var(--muted)}.status-pill.live{color:var(--good);border-color:#26775e}
    .card{background:linear-gradient(150deg,#182b44,#122035);border:1px solid #304258;box-shadow:0 12px 32px #0003;border-radius:23px;padding:20px;margin:0 0 15px}
    .intro{font-size:13px;color:var(--muted);line-height:1.6;margin:8px 0 20px}.small{font-size:12px;line-height:1.5;color:var(--muted)}label{display:block;font-size:13px;font-weight:650;margin-bottom:9px}
    input{width:100%;height:54px;background:#0a1728;color:#f5fbff;font-size:16px;border:1px solid #3a526c;padding:0 15px;border-radius:13px;outline:none}input:focus{border-color:var(--accent)}
    button{appearance:none;-webkit-appearance:none;min-height:48px;border:1px solid #36506a;border-radius:12px;background:#1c3650;color:#ecf7ff;font:700 14px inherit;font-size:14px;font-weight:700;cursor:pointer;touch-action:manipulation;transition:background .12s}
    button:active:not(:disabled){background:#32749c;transform:scale(.985)}button:disabled{opacity:.36;cursor:not-allowed}button:focus-visible{outline:3px solid var(--accent);outline-offset:2px}
    button.primary{background:#1683b4;border-color:#359fcc;color:#fff}button.danger{background:#4a2235;border-color:#7c3e53;color:#ffe5eb}button.selected{background:#245c76;border-color:#54c1ed;color:#fff}
    .full{width:100%;margin-top:13px}.actions{display:grid;grid-template-columns:1fr 1fr;gap:10px;margin-top:17px}.divider{height:1px;background:var(--line);margin:19px 0}
    .control-head{display:flex;justify-content:space-between;align-items:center}.subtle{font-size:11px;color:#91acc5;letter-spacing:.08em;text-transform:uppercase}.bigtemp{text-align:center;font-size:80px;letter-spacing:-.075em;line-height:1;font-weight:300;margin:20px 0 14px}.degree{font-size:34px;vertical-align:top;margin-top:12px;display:inline-block;letter-spacing:-.03em}
    .temp-controls{display:grid;grid-template-columns:60px 1fr 60px;gap:12px;align-items:center}.temp-controls button{height:58px;font-size:30px}.fan{display:grid;grid-template-columns:repeat(6,minmax(0,1fr));gap:7px}.fan button{min-height:47px;font-size:14px;padding:0}.wind{display:grid;grid-template-columns:repeat(3,1fr);gap:8px}.wind button{font-size:12px}
    .notice{background:#10283a;border:1px solid #2f5775;padding:12px 14px;border-radius:13px;font-size:13px;line-height:1.5;margin-top:14px;color:#c8eafa}.notice.error{border-color:#a25b61;background:#3d2230;color:#ffd6da}.notice.ok{border-color:#257c67;color:#bcffe9}
    .ghost{border:0;background:transparent;color:var(--muted);text-decoration:underline;padding:4px;min-height:30px}.footer{display:flex;justify-content:space-between;gap:12px;align-items:center;margin-top:12px}.hidden{display:none!important}
    @media(prefers-reduced-motion:reduce){button{transition:none}}@media(max-width:365px){.card{padding:16px}.heading{font-size:23px}.bigtemp{font-size:68px}.wind{grid-template-columns:1fr}.fan{gap:4px}.fan button{font-size:12px}}
  </style>
</head>
<body>
<main>
  <header class="header">
    <div><div class="eyebrow">KhaiRC · Home Control</div><h1 class="heading">Toshiba AC</h1></div>
    <div id="connection" class="status-pill" aria-live="polite">Đang kiểm tra…</div>
  </header>
  <section id="login-card" class="card hidden" aria-labelledby="login-title">
    <h2 id="login-title" style="margin:0">Đăng nhập Hub</h2>
    <p class="intro">Chỉ hoạt động trong mạng LAN. Nhập API key đã cấu hình trên ESP32 để mở phiên điều khiển HTTPS trong 15 phút.</p>
    <form method="post" action="/web/login" autocomplete="off">
      <label for="key">HUB_API_KEY (64 ký tự)</label>
      <input id="key" name="api_key" type="password" minlength="64" maxlength="64" required autocomplete="off" autocapitalize="none" spellcheck="false">
      <button class="full primary" type="submit">ĐĂNG NHẬP BẢO MẬT</button>
    </form>
    <p class="small">Mã không được nhúng vào trang hoặc lưu trên iPhone. Cookie phiên có HttpOnly, Secure và SameSite=Strict.</p>
  </section>
  <section id="remote" class="hidden" aria-label="Điều khiển Toshiba">
    <div class="card">
      <div class="control-head"><div><div class="eyebrow">Climate controller</div><p class="small" style="margin:6px 0 0" id="power-caption">Chưa biết trạng thái thực tế</p></div><span id="power-badge" class="status-pill">Chưa xác minh</span></div>
      <div class="bigtemp" aria-live="polite"><span id="temperature">24</span><span class="degree">°C</span></div>
      <div class="temp-controls"><button id="temp-down" aria-label="Giảm nhiệt độ 1 độ C" disabled>−</button><div style="text-align:center;font-size:12px;color:var(--muted)">Thiết lập COOL<br><strong id="fan-summary" style="color:#fff">Fan AUTO</strong></div><button id="temp-up" aria-label="Tăng nhiệt độ 1 độ C" disabled>+</button></div>
      <div class="actions"><button id="power-on" class="primary">BẬT MÁY LẠNH</button><button id="power-off" class="danger">TẮT MÁY LẠNH</button></div>
      <button class="full" id="cool">GỬI COOL</button>
      <div class="divider"></div>
      <label>Tốc độ quạt</label>
      <div id="fan-controls" class="fan" role="group" aria-label="Tốc độ quạt">
        <button data-fan="auto" class="selected" disabled>A</button><button data-fan="1" disabled>1</button><button data-fan="2" disabled>2</button><button data-fan="3" disabled>3</button><button data-fan="4" disabled>4</button><button data-fan="5" disabled>5</button>
      </div>
      <div class="divider"></div>
      <label>Hướng gió</label>
      <div class="wind"><button id="fix" disabled>FIX</button><button id="swing-on" disabled>SWING ON</button><button id="swing-off" disabled>SWING OFF</button></div>
      <div id="notice" class="notice" role="status" aria-live="polite">Các trạng thái trên màn hình chỉ là ước tính sau khi gửi IR, không phải phản hồi trực tiếp từ Toshiba.</div>
      <button id="review" class="full danger hidden">TÔI ĐÃ KIỂM TRA MÁY LẠNH · MỞ KHÓA</button>
    </div>
    <div class="footer"><span class="small">HTTPS · KhaiRC Hub · Chỉ Toshiba</span><button id="logout" class="ghost">Đăng xuất</button></div>
  </section>
  <p class="small" style="text-align:center">Không có kết nối Internet, VPS, cloud hoặc OTA trong giao diện này.</p>
</main>
<script src="/web/app.js" defer></script>
</body></html>
)KHAIRCSTAGE3A";
const char kScript[] PROGMEM = R"KHAIRCSTAGE3A('use strict';
// Stage 3A: never persist API keys, CSRF, or command state in browser storage.
// Every command is initiated by an explicit tap. No automatic retries.
(() => {
  const $ = id => document.getElementById(id);
  const state = { csrf: null, busy: false, uncertain: false, power: null, temperature: 24, fan: 'auto', swing: null };
  const buttons = ['power-on','power-off','cool','temp-up','temp-down','fix','swing-on','swing-off'];
  const setNotice = (text, kind = '') => { $('notice').textContent = text; $('notice').className = 'notice' + (kind ? ' ' + kind : ''); };
  const setConnected = (text, live) => { $('connection').textContent = text; $('connection').classList.toggle('live', !!live); };
  const setAuthenticated = logged => { $('login-card').classList.toggle('hidden', logged); $('remote').classList.toggle('hidden', !logged); };
  function render() {
    $('temperature').textContent = String(state.temperature);
    $('fan-summary').textContent = 'Fan ' + (state.fan === 'auto' ? 'AUTO' : state.fan);
    $('power-badge').textContent = state.power === null ? 'Chưa xác minh' : state.power ? 'Đã gửi ON' : 'Đã gửi OFF';
    $('power-caption').textContent = 'Máy lạnh không trả về trạng thái thực tế';
    const disabled = state.busy || state.uncertain || !state.csrf;
    for (const id of buttons) $(id).disabled = disabled;
    $('cool').disabled = disabled;
    $('temp-up').disabled = disabled || state.power !== true || state.temperature >= 30;
    $('temp-down').disabled = disabled || state.power !== true || state.temperature <= 17;
    for (const button of document.querySelectorAll('[data-fan]')) {
      button.disabled = disabled || state.power !== true;
      button.classList.toggle('selected', button.dataset.fan === state.fan);
    }
    for (const id of ['fix','swing-on','swing-off']) $(id).disabled = disabled || state.power !== true;
    $('review').classList.toggle('hidden', !state.uncertain);
  }
  async function boot() {
    setAuthenticated(false);
    try {
      const response = await fetch('/web/session', {cache:'no-store', credentials:'same-origin', redirect:'error'});
      if (response.status === 401) { setConnected('Cần đăng nhập', false); return; }
      if (!response.ok) throw Error('session_http');
      const data = await response.json();
      if (data.authenticated !== true || !/^[0-9a-f]{32}$/.test(data.csrf || '')) throw Error('invalid_session');
      state.csrf = data.csrf;
      state.busy = true; render();
      setAuthenticated(true);
      const health = await fetch('/api/v1/health', {cache:'no-store', credentials:'same-origin', redirect:'error'});
      if (!health.ok) throw Error('health_http');
      const dataHealth = await health.json();
      if (dataHealth.status !== 'ok' || dataHealth.device !== 'KhaiRC-ESP32-Hub') throw Error('health_invalid');
      setConnected('LAN · TLS', true);
      state.busy = false; render();
    } catch (_) {
      setConnected('Không kết nối Hub', false);
      if (state.csrf) { setAuthenticated(true); setNotice('Không thể xác minh health của Hub. Không gửi lệnh.', 'error'); state.busy = false; state.uncertain = true; render(); }
    }
  }
  async function sendAction(body, nextState) {
    if (!state.csrf || state.busy || state.uncertain) return;
    state.busy = true; render();
    setNotice('Đang gửi đúng một lệnh qua HTTPS…');
    try {
      const response = await fetch('/web/command', {
        method:'POST', credentials:'same-origin', cache:'no-store', redirect:'error',
        headers:{'Content-Type':'application/json','X-CSRF-Token':state.csrf},
        body:JSON.stringify(body)
      });
      if (response.status === 401) { state.csrf = null; setAuthenticated(false); setConnected('Phiên hết hạn', false); return; }
      const data = await response.json();
      if (!response.ok) {
        const code = (data && data.error && typeof data.error.code === 'string') ? data.error.code : 'http_' + response.status;
        // A 500 from RMT may mean uncertain physical outcome: lock for inspection.
        if (response.status >= 500) throw Error('server_uncertain');
        setNotice('Hub từ chối lệnh (' + code + '). Không tự gửi lại.', 'error');
        return;
      }
      if (data.schema_version !== 1 || data.device_id !== 'toshiba_ac' ||
          data.action !== body.action || data.status !== 'sent' ||
          data.state_verified !== false) throw Error('invalid_ack');
      Object.assign(state, nextState);
      setNotice('ESP32 đã phát IR. Toshiba không phản hồi trạng thái; hãy quan sát máy lạnh.', 'ok');
    } catch (_) {
      state.uncertain = true;
      setNotice('CHƯA RÕ lệnh đã phát hay chưa. Kiểm tra máy lạnh trước khi mở khóa. Không tự gửi lại.', 'error');
    } finally { state.busy = false; render(); }
  }
  const stateBody = (power, temp = state.temperature, fan = state.fan) =>
    ({action:'state', power:power, temperature_c:temp, fan_speed:fan});
  $('power-on').addEventListener('click', () => sendAction(stateBody(true), {power:true}));
  $('power-off').addEventListener('click', () => sendAction(stateBody(false), {power:false}));
  $('cool').addEventListener('click', () => sendAction(stateBody(true), {power:true}));
  $('temp-up').addEventListener('click', () => { if(state.power) sendAction(stateBody(true,state.temperature+1),{temperature:state.temperature+1}); });
  $('temp-down').addEventListener('click', () => { if(state.power) sendAction(stateBody(true,state.temperature-1),{temperature:state.temperature-1}); });
  for (const button of document.querySelectorAll('[data-fan]')) button.addEventListener('click', () => {
    const fan = button.dataset.fan;
    if(state.power) sendAction(stateBody(true,state.temperature,fan),{fan});
  });
  $('fix').addEventListener('click', () => sendAction({action:'fix'}, {}));
  $('swing-on').addEventListener('click', () => sendAction({action:'swing_on'}, {swing:true}));
  $('swing-off').addEventListener('click', () => sendAction({action:'swing_off'}, {swing:false}));
  $('review').addEventListener('click', () => {
    state.uncertain = false;
    state.power = null;
    state.swing = null;
    setNotice('Đã mở khóa sau khi kiểm tra thực tế. Chọn BẬT hoặc TẮT để thiết lập lại trạng thái ước tính.');
    render();
  });
  $('logout').addEventListener('click', async () => {
    if (!state.csrf || state.busy) return;
    try { await fetch('/web/logout', {method:'POST', credentials:'same-origin', redirect:'error', headers:{'X-CSRF-Token':state.csrf}}); }
    catch (_) { /* Session will expire server-side. */ }
    state.csrf = null; state.power = null; state.swing = null;
    setAuthenticated(false); setConnected('Đã đăng xuất', false); render();
  });
  render();
  boot();
})();
)KHAIRCSTAGE3A";
const char kManifest[] PROGMEM = R"KHAIRCSTAGE3A({"name":"KhaiRC · Toshiba AC","short_name":"KhaiRC","start_url":"/ui","scope":"/","display":"standalone","background_color":"#081322","theme_color":"#081322","icons":[{"src":"/web/icon.png","sizes":"180x180","type":"image/png","purpose":"any"},{"src":"/web/icon.svg","sizes":"any","type":"image/svg+xml","purpose":"any"}]}
)KHAIRCSTAGE3A";
const char kIcon[] PROGMEM = R"KHAIRCSTAGE3A(<svg xmlns="http://www.w3.org/2000/svg" viewBox="0 0 192 192"><rect width="192" height="192" rx="42" fill="#081322"/><circle cx="96" cy="96" r="60" stroke="#65d6ff" stroke-width="11" fill="none"/><g fill="none" stroke="#65d6ff" stroke-width="9" stroke-linecap="round"><path d="M96 52v88M52 96h88M66 66l60 60M126 66l-60 60"/></g></svg>
)KHAIRCSTAGE3A";
const std::uint8_t kIconPng[] PROGMEM = {0x89, 0x50, 0x4e, 0x47, 0x0d, 0x0a, 0x1a, 0x0a, 0x00, 0x00, 0x00, 0x0d, 0x49,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 0x60, 0x82};
}

namespace WebUiPage {
const char* html() { return kHtml; }
const char* script() { return kScript; }
const char* manifest() { return kManifest; }
const char* icon() { return kIcon; }
const std::uint8_t* iconPng() { return kIconPng; }
std::size_t iconPngLen() { return sizeof(kIconPng); }
}
